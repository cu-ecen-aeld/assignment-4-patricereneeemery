## base_external/Config.in
```kconfig
menu "AESD custom packages"

source "$BR2_EXTERNAL/package/aesdsocket/Config.in"

endmenu
```

## base_external/package/Config.in
```kconfig
menu "External packages"

source "$BR2_EXTERNAL/package/aesd-assignments/Config.in"

endmenu
```

## base_external/package/aesdsocket/Config.in
```kconfig
config BR2_PACKAGE_AESDSOCKET
    bool "aesdsocket"
    help
      Install the aesdsocket server and init script.
```
